#include "ili9341.h"
#include <string.h>

// ----------------------- SPI handle & control lines -----------------------
static SPI_HandleTypeDef *tft_spi;

static inline void CS_LOW(void){  HAL_GPIO_WritePin(ILI9341_CS_GPIO,  ILI9341_CS_PIN,  GPIO_PIN_RESET); }
static inline void CS_HIGH(void){ HAL_GPIO_WritePin(ILI9341_CS_GPIO,  ILI9341_CS_PIN,  GPIO_PIN_SET);   }
static inline void DC_CMD(void){  HAL_GPIO_WritePin(ILI9341_DC_GPIO,  ILI9341_DC_PIN,  GPIO_PIN_RESET); }
static inline void DC_DATA(void){ HAL_GPIO_WritePin(ILI9341_DC_GPIO,  ILI9341_DC_PIN,  GPIO_PIN_SET);   }
static inline void RST_LOW(void){ HAL_GPIO_WritePin(ILI9341_RST_GPIO, ILI9341_RST_PIN, GPIO_PIN_RESET); }
static inline void RST_HIGH(void){HAL_GPIO_WritePin(ILI9341_RST_GPIO, ILI9341_RST_PIN, GPIO_PIN_SET);   }

static void write_cmd(uint8_t cmd){
  DC_CMD(); CS_LOW();
  HAL_SPI_Transmit(tft_spi, &cmd, 1, HAL_MAX_DELAY);
  CS_HIGH();
}
static void write_data(const uint8_t *data, uint32_t len){
  if(!len) return;
  DC_DATA(); CS_LOW();
  HAL_SPI_Transmit(tft_spi, (uint8_t*)data, (uint16_t)len, HAL_MAX_DELAY);
  CS_HIGH();
}
static void write_data8(uint8_t d){ write_data(&d,1); }

// ----------------------- Address window & dimensions -----------------------
static uint16_t _width  = ILI9341_WIDTH_NATIVE;
static uint16_t _height = ILI9341_HEIGHT_NATIVE;

static void set_addr_window(uint16_t x0, uint16_t y0, uint16_t x1, uint16_t y1){
  // Caller must ensure x0<=x1 < _width and y0<=y1 < _height
  uint8_t buf[4];
  write_cmd(0x2A); // Column Address Set
  buf[0] = x0 >> 8; buf[1] = x0 & 0xFF; buf[2] = x1 >> 8; buf[3] = x1 & 0xFF;
  write_data(buf,4);

  write_cmd(0x2B); // Page Address Set
  buf[0] = y0 >> 8; buf[1] = y0 & 0xFF; buf[2] = y1 >> 8; buf[3] = y1 & 0xFF;
  write_data(buf,4);

  write_cmd(0x2C); // Memory Write
}

uint16_t ILI9341_GetWidth(void){  return _width;  }
uint16_t ILI9341_GetHeight(void){ return _height; }

// ----------------------- Init & Rotation -----------------------
void ILI9341_SetRotation(ILI9341_Rotation rot){
  // Update MADCTL, then adjust logical width/height
  write_cmd(0x36);
  write_data8((uint8_t)rot);

  if(rot == ILI9341_ROT_0 || rot == ILI9341_ROT_180){
    _width  = ILI9341_WIDTH_NATIVE;   // 240
    _height = ILI9341_HEIGHT_NATIVE;  // 320
  } else {
    _width  = ILI9341_HEIGHT_NATIVE;  // 320
    _height = ILI9341_WIDTH_NATIVE;   // 240
  }
}

void ILI9341_Init(SPI_HandleTypeDef *hspi){
  tft_spi = hspi;

  RST_HIGH(); CS_HIGH(); DC_DATA();
  RST_LOW();  HAL_Delay(20);
  RST_HIGH(); HAL_Delay(150);

  // Standard power/VRH/VCOM sequence (tested good on ILI9341)
  write_cmd(0xEF); uint8_t ef[]={0x03,0x80,0x02}; write_data(ef,3);
  write_cmd(0xCF); uint8_t cf[]={0x00,0xC1,0x30}; write_data(cf,3);
  write_cmd(0xED); uint8_t ed[]={0x64,0x03,0x12,0x81}; write_data(ed,4);
  write_cmd(0xE8); uint8_t e8[]={0x85,0x00,0x78}; write_data(e8,3);
  write_cmd(0xCB); uint8_t cb[]={0x39,0x2C,0x00,0x34,0x02}; write_data(cb,5);
  write_cmd(0xF7); write_data8(0x20);
  write_cmd(0xEA); uint8_t ea[]={0x00,0x00}; write_data(ea,2);

  write_cmd(0xC0); write_data8(0x23);           // Power control 1
  write_cmd(0xC1); write_data8(0x10);           // Power control 2
  write_cmd(0xC5); uint8_t c5[]={0x3E,0x28}; write_data(c5,2); // VCOM 1
  write_cmd(0xC7); write_data8(0x86);           // VCOM 2

  // Default portrait + BGR
  ILI9341_SetRotation(ILI9341_ROT_0);           // sets MADCTL and _width/_height

  write_cmd(0x3A); write_data8(0x55);           // Pixel format: 16-bit
  write_cmd(0xB1); uint8_t b1[]={0x00,0x18}; write_data(b1,2); // Frame rate
  write_cmd(0xB6); uint8_t b6[]={0x08,0x82,0x27}; write_data(b6,3); // Display func
  write_cmd(0xF2); write_data8(0x00);           // 3Gamma off
  write_cmd(0x26); write_data8(0x01);           // Gamma curve

  uint8_t e0[]={0x0F,0x31,0x2B,0x0C,0x0E,0x08,0x4E,0xF1,0x37,0x07,0x10,0x03,0x0E,0x09,0x00};
  write_cmd(0xE0); write_data(e0,sizeof(e0));
  uint8_t e1[]={0x00,0x0E,0x14,0x03,0x11,0x07,0x31,0xC1,0x48,0x08,0x0F,0x0C,0x31,0x36,0x0F};
  write_cmd(0xE1); write_data(e1,sizeof(e1));

  write_cmd(0x11); HAL_Delay(120);              // Sleep Out
  write_cmd(0x29);                              // Display ON

  ILI9341_FillScreen(COLOR_BLACK);
}

// ----------------------- Primitives -----------------------
void ILI9341_FillScreen(uint16_t color){
  ILI9341_FillRect(0,0,_width,_height,color);
}

void ILI9341_DrawPixel(uint16_t x, uint16_t y, uint16_t color){
  if(x >= _width || y >= _height) return; // clip
  set_addr_window(x,y,x,y);
  uint8_t px[2] = { (uint8_t)(color>>8), (uint8_t)(color & 0xFF) };
  DC_DATA(); CS_LOW();
  HAL_SPI_Transmit(tft_spi, px, 2, HAL_MAX_DELAY);
  CS_HIGH();
}

void ILI9341_FillRect(uint16_t x, uint16_t y, uint16_t w, uint16_t h, uint16_t color){
  // Clip rectangle to screen bounds
  if(x >= _width || y >= _height) return;
  if((x + w) > _width)  w = _width - x;
  if((y + h) > _height) h = _height - y;

  set_addr_window(x, y, x + w - 1, y + h - 1);

  // Stream pixels in chunks
  uint32_t pixels = (uint32_t)w * (uint32_t)h;
  uint8_t chunk[2*128]; // 128 pixels per burst
  for(int i=0;i<128;i++){ chunk[2*i] = (uint8_t)(color>>8); chunk[2*i+1] = (uint8_t)(color & 0xFF); }

  DC_DATA(); CS_LOW();
  while(pixels){
    uint16_t n = (pixels > 128) ? 128 : (uint16_t)pixels;
    HAL_SPI_Transmit(tft_spi, chunk, (uint16_t)(2*n), HAL_MAX_DELAY);
    pixels -= n;
  }
  CS_HIGH();
}

// ----------------------- 5x7 Font & Text -----------------------
// Each character is 5 columns × 7 rows, LSB at top; we add 1 column spacing.
static const uint8_t font5x7[96][5] = {
  // ASCII 0x20..0x7E (space..~). Each 5 bytes is one glyph column-wise.
  {0x00,0x00,0x00,0x00,0x00}, // 0x20 ' '
  {0x00,0x00,0x5F,0x00,0x00}, // 0x21 '!'
  {0x00,0x07,0x00,0x07,0x00}, // 0x22 '"'
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  {0x08,0x04,0x08,0x10,0x08}  // 0x7E '~'
};

void ILI9341_DrawChar(uint16_t x, uint16_t y, char c,
                      uint16_t fg, uint16_t bg, uint8_t scale){
  if(c < 0x20 || c > 0x7E) c = '?';
  uint16_t w = (uint16_t)(6 * scale);  // 5 cols + 1 spacing
  uint16_t h = (uint16_t)(8 * scale);  // 7 rows + 1 spacing

  // Full glyph clip (optional early-out):
  if(x >= _width || y >= _height) return;
  if((x + w) <= 0 || (y + h) <= 0)  return;

  // Draw background block (fast) then overwrite foreground pixels
  ILI9341_FillRect(x, y, w, h, bg);

  const uint8_t *glyph = font5x7[c - 0x20];
  for(uint8_t col=0; col<5; col++){
    uint8_t bits = glyph[col];
    for(uint8_t row=0; row<7; row++){
      if(bits & (1U << row)){
        // Draw a scale×scale block for each foreground bit
        uint16_t px = x + (uint16_t)col * scale;
        uint16_t py = y + (uint16_t)row * scale;
        ILI9341_FillRect(px, py, scale, scale, fg);
      }
    }
  }
}

void ILI9341_DrawString(uint16_t x, uint16_t y, const char *str,
                        uint16_t fg, uint16_t bg, uint8_t scale){
  uint16_t cursor = x;
  uint16_t step   = (uint16_t)(6 * scale); // advance per char
  while(*str){
    if(*str == '\n'){ y += (uint16_t)(8 * scale); cursor = x; str++; continue; }
    if(*str == '\r'){ str++; continue; }
    ILI9341_DrawChar(cursor, y, *str, fg, bg, scale);
    cursor += step;
    str++;
    // Optional wrap: if next char crosses width → move to new line
    if((cursor + step) > _width){
      y += (uint16_t)(8 * scale);
      cursor = x;
    }
    if(y + (uint16_t)(8 * scale) > _height) break; // no more space
  }
}
